## drivers/serial/Kconfig.rpi_pico
```kconfig
# Copyright (c) 2021 Yonatan Schachter
# SPDX-License-Identifier: Apache-2.0

config UART_RPI_PICO_PIO
	bool "Raspberry Pi PIO UART driver"
	default y
	depends on DT_HAS_RASPBERRYPI_PICO_UART_PIO_ENABLED
	depends on PIO_RPI_PICO
	select SERIAL_HAS_DRIVER
	select SERIAL_SUPPORT_INTERRUPT
	select PICOSDK_USE_PIO
	select PICOSDK_USE_CLAIM
	select PINCTRL
	select DMA if UART_INTERRUPT_DRIVEN
	select DMA_RPI_PICO if UART_INTERRUPT_DRIVEN
	depends on RESET

if UART_RPI_PICO_PIO && UART_INTERRUPT_DRIVEN

config UART_RPI_PICO_PIO_POLL_STACK_SIZE
	int "Stack size of the thread draining the PIO UART"
	default 512
	help
	  The PIO UART only exposes a polled interface for TX, and RX is
	  captured by DMA into a ring buffer independently of the CPU, and
	  kept running indefinitely by a second, hardware-chained DMA channel
	  (no software reload involved). This dedicated thread periodically
	  invokes the registered uart_irq_callback so consumers (modem_chat,
	  the Bluetooth H:4 backend, ...) get serviced.

config UART_RPI_PICO_PIO_POLL_THREAD_PRIORITY
	int "Priority of the PIO UART service thread"
	default 1
	help
	  A high, but not the highest, priority. RX bytes are already safe in
	  the DMA ring by the time this thread runs (see
	  UART_RPI_PICO_PIO_RX_RING_BUF_SIZE), so this thread no longer has to
	  win every scheduling race the way a driver bit-banging the hardware
	  FIFO directly would. Running it at the system's most extreme
	  cooperative priority starved other low-priority threads that also
	  need to run (e.g. deferred log processing) under sustained traffic.

config UART_RPI_PICO_PIO_POLL_PERIOD_US
	int "Poll period, in microseconds, of the PIO UART service thread"
	default 2000
	help
	  How often the thread above runs. RX bytes are safe in the DMA ring
	  regardless of this value (see UART_RPI_PICO_PIO_RX_RING_BUF_SIZE),
	  so this trades off two things against each other, not data loss
	  risk either way:
	  - Too short, and with one such thread per PIO UART instance, the
	    combined polling load can starve other low-priority threads in
	    the system (e.g. deferred log processing) of CPU time.
	  - Too long, and the uart_irq_callback gets invoked less often,
	    which can deliver bytes to it in larger bursts; layers above
	    this driver (e.g. modem_backend_uart_isr) were not necessarily
	    sized to absorb a burst that big in one call.

config UART_RPI_PICO_PIO_RX_RING_BUF_SIZE
	int "Size, in bytes, of the RX DMA ring buffer"
	default 256
	range 2 32768
	help
	  Must be a power of two: the DMA channel's hardware address-wrapping
	  only supports power-of-two ring sizes. RX bytes are captured here
	  by DMA straight out of the PIO hardware FIFO (which is only 4-8
	  bytes deep) at the state machine's own pace, independently of the
	  CPU. This is the real slack budget for how far the service thread
	  above can fall behind before bytes are actually lost; size it for
	  the longest realistic stall (e.g. a debugger halt, a higher-
	  priority thread hogging the CPU) at the configured baudrate.

endif # UART_RPI_PICO_PIO && UART_INTERRUPT_DRIVEN
```

## drivers/usb/udc/Kconfig.mchp
```kconfig
# Copyright(c) 2026 Microchip Technology Inc.
# SPDX-License-Identifier: Apache-2.0

config UDC_MCHP_G1
	bool
	default y
	depends on DT_HAS_MICROCHIP_USB_G1_ENABLED
	select PINCTRL
	select SYS_MEM_BLOCKS
	select EVENTS
	help
	  USB Device Controller Driver for USB G1 group of IPs.

if UDC_MCHP_G1

config UDC_MCHP_G1_STACK_SIZE
	int "UDC controller driver internal thread stack size"
	default 512
	help
	  Device controller driver internal thread stack size.

config UDC_MCHP_G1_THREAD_PRIORITY
	int "UDC controller driver thread priority"
	default 8
	help
	  Device controller driver thread priority.

endif # UDC_MCHP_G1

config UDC_MCHP_SAM
	bool "Microchip SAM UDPHS USB Device High Speed Port"
	default y
	depends on DT_HAS_MICROCHIP_SAM_UDPHS_ENABLED
	select PINCTRL
	select GPIO
	select SYS_MEM_BLOCKS
	select EVENTS
	select UDC_DRIVER_HAS_HIGH_SPEED_SUPPORT
	help
	  Enable the Microchip SAM UDPHS driver.

if UDC_MCHP_SAM

config UDC_MCHP_SAM_STACK_SIZE
	int "UDC controller driver internal thread stack size"
	default 1024
	help
	  Device controller driver internal thread stack size.

config UDC_MCHP_SAM_THREAD_PRI
	int "UDC controller driver thread priority"
	default 8
	help
	  Device controller driver thread priority.

config UDC_MCHP_SAM_DMA
	bool "DMA support"
	default y
	help
	  Enable DMA transfer, otherwise data will be transferred via FIFO.

config UDC_MCHP_SAM_BURST_LOCK
	bool "Lock bus access for maximum bandwidth"
	help
	  USB packets system data bursts will be locked for
	  maximum optimization of the bus bandwidth usage.

endif # UDC_MCHP_SAM
```

## dts/bindings/ethernet/phy/microchip,ksz8091.yaml
```yaml
# Copyright (c) 2026 Microchip Technology Inc.
# SPDX-License-Identifier: Apache-2.0

description: Microchip KSZ8091 Ethernet PHY device

compatible: "microchip,ksz8091"

include: microchip,ksz8081.yaml
```

## dts/bindings/flash_controller/microchip,nvmctrl-g2.yaml
```yaml
# Copyright (c) 2026 Microchip Technology Inc.
# SPDX-License-Identifier: Apache-2.0

title: Microchip NVMCTRL (Nonvolatile Memory Controller)

description: |
  Microchip NVMCTRL driver for Flash

  Group g2 NVMCTRL driver supports following hardware peripherals:
    - module name="NVMCTRL" id="03929" version="1a0"

compatible: "microchip,nvmctrl-g2"

include: flash-controller.yaml

properties:
  clock-parent:
    type: phandle
    description: Reference to the clock node
```

## dts/bindings/mtd/microchip,flash-g2.yaml
```yaml
# Copyright (c) 2025-2026 Microchip Technology Inc.
# SPDX-License-Identifier: Apache-2.0

title: Microchip Flash G2

description: |
  Microchip G2 driver for Flash

  Group g2 NVMCTRL driver supports following hardware peripherals:
    - module name="NVMCTRL" id="03929" version="1a0"

compatible: "microchip,flash-g2"

include: soc-nv-flash.yaml

properties:
  unsupported-region:
    type: array
    description: array of unaddressable regions in the given flash area
  data-flash-start-addr:
    type: int
    description: starting address of data flash region
  user-row-start-addr:
    type: int
    description: starting address of user-row flash region
```

## dts/bindings/sdhc/microchip,sdhc-g1.yaml
```yaml
# Copyright (c) 2026 Microchip Technology Inc.
# SPDX-License-Identifier: Apache-2.0

title: Microchip SDHC controller

description: |
  Microchip SDHC controller driver.

  Microchip G1 SDHC controller driver supports the following hardware peripheral:
    - module name="SDHC" compatible="microchip,sdhc-g1"

  The node must specify the register region, the controller interrupt, the
  main, generic and slow generic clock sources (named "mclk", "gclk" and
  "gclk-slow"), and a pinctrl configuration for the SD bus pads.

compatible: "microchip,sdhc-g1"

include:
  - name: sdhc.yaml
  - name: pinctrl-device.yaml

properties:
  reg:
    required: true
    description: |
      Base address and size of the SDHC controller register region.

  clocks:
    required: true
    description: |
      Clock sources driving the SDHC controller.

  clock-names:
    required: true
    description: |
      Names of the clock sources listed in "clocks", in the same order.
      Must be "mclk" (main clock), "gclk" (generic clock) and "gclk-slow"
      (slow generic clock).

  interrupts:
    required: true
    description: |
      SDHC controller interrupt line.

  max-bus-freq:
    type: int
    default: 400000
    description: |
      Maximum bus frequency for SD card. This should be the highest frequency
      the SDHC is capable of negotiating with cards on the bus.

  min-bus-freq:
    type: int
    default: 400000
    description: |
      Minimum bus frequency for SD card. This should be the frequency that
      cards first will select when attached to the SDHC bus

  power-delay-ms:
    type: int
    default: 500
    description: |
      time in ms for SDHC to delay when toggling power to the SD card. This
      delay gives the card time to power up or down fully

  pinctrl-0:
    required: true
    description: |
      Pin configuration for the SD bus pads in the default state.

  pinctrl-names:
    required: true
    description: |
      Names of the pinctrl states defined for this controller. Must include
      "default" matching pinctrl-0.

examples:
  - |
    #Example devicetree configuration for Microchip G1 SDHC controller:

    sdhc0: sdhc@46000000 {
            compatible = "microchip,sdhc-g1";
            reg = <0x46000000 0x234>;
            interrupts = <136 0>;
            clocks = <&mclkperiph CLOCK_MCHP_MCLKPERIPH_ID_AHB_SDHC1>,
                     <&gclkperiph CLOCK_MCHP_GCLKPERIPH_ID_SDHC1>,
                     <&gclkperiph CLOCK_MCHP_GCLKPERIPH_ID_SDHC1_SLOW>;
            clock-names = "mclk", "gclk", "gclk-slow";
            min-bus-freq = <400000>;
            max-bus-freq = <25000000>;
            pinctrl-0 = <&sdhc0_default>;
            pinctrl-names = "default";
            status = "okay";
    };
```

## tests/drivers/flash/erase_blocks/testcase.yaml
```yaml
# Copyright (c) 2023 Bjarki Arge Andreasen
# SPDX-License-Identifier: Apache-2.0

common:
  sysbuild: true
  tags:
    - drivers
    - flash
tests:
  flash.erase_blocks.build_only:
    harness: ztest
    build_only: true
    platform_allow:
      - sam_v71_xult/samv71q21
      - b_u585i_iot02a
      - nrf9160dk/nrf9160
      - nrf5340dk/nrf5340/cpuapp
      - frdm_mcxc444
      - frdm_imxrt1186/mimxrt1186/cm33
      - frdm_imxrt1186/mimxrt1186/cm7
      - pic32cx_sg41_cult
      - pic32cx_sg61_cult
      - sam_e54_xpro
      - pic32cz_ca80_cult
      - pic32cz_ca90_cult
    integration_platforms:
      - nrf9160dk/nrf9160
```

## tests/drivers/flash/negative_tests/testcase.yaml
```yaml
common:
  tags:
    - drivers
    - flash
tests:
  drivers.flash.negative_tests:
    platform_allow:
      - nrf54h20dk/nrf54h20/cpuapp
      - nrf54l15dk/nrf54l15/cpuapp
      - nrf54lm20dk/nrf54lm20a/cpuapp
      - nrf54lm20dk/nrf54lm20b/cpuapp
      - ophelia4ev/nrf54l15/cpuapp
      - sam_e54_xpro
      - pic32cm_jh01_cpro
      - pic32cz_ca80_cult
      - pic32cx_sg41_cult
      - pic32cx_sg61_cult
```

## tests/drivers/pinctrl/microchip/boards/pic32cz_ca90_cult.conf
```kconfig
# Copyright (c) 2026 Microchip Technology Inc.
# SPDX-License-Identifier: Apache-2.0

CONFIG_PIN_DRIVE_STRENGTH=n
```

## tests/drivers/pinctrl/microchip/testcase.yaml
```yaml
tests:
  drivers.pinctrl.microchip:
    tags:
      - drivers
      - pinctrl
    platform_allow:
      - sam_e54_xpro
      - pic32cx_sg41_cult
      - pic32cx_sg61_cult
      - pic32cm_jh01_cpro
      - pic32cz_ca80_cult
      - pic32cz_ca90_cult
```
