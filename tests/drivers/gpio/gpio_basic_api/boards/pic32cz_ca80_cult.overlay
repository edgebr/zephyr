/*
 * Copyright (c) 2026 Microchip Technology Inc.
 *
 * SPDX-License-Identifier: Apache-2.0
 */

/ {
	resources {
		compatible = "test-gpio-basic-api";
		out-gpios = <&porta 7 0>;
		in-gpios = <&porta 8 0>;
	};
};

&porta {
	status = "okay";
};
