/*
 * Copyright (c) 2026 Microchip Technology Inc.
 *
 * SPDX-License-Identifier: Apache-2.0
 */

/* Connect PB21 to PB22 */

dut: &sercom3 {
	compatible = "microchip,sercom-g1-uart";
	#address-cells = <1>;
	#size-cells = <0>;
	current-speed = <115200>;
	data-bits = <8>;
	parity = "none";
	stop-bits = "1";
	rxpo = <1>;
	txpo = <0>;
	pinctrl-0 = <&sercom3_uart_default>;
	pinctrl-names = "default";
	status = "okay";
};

&pinctrl {
	sercom3_uart_default: sercom3_uart_default {
		group1 {
			pinmux = <PB21C_SERCOM3_PAD0>,
				 <PB22C_SERCOM3_PAD1>;
		};
	};
};
