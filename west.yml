## west.yml
```yaml
# The west manifest file for upstream Zephyr.
#
# The per-installation west configuration file, .west/config, sets the
# path to the project containing this file in the [manifest] section's
# "path" variable.
#
# You are free to create your own manifest files and put them in any
# repository you want, to create your own custom Zephyr installations.
# For example, you could create a manifest file in your own out of
# tree application directory, which would pull this zephyr repository
# in as an ordinary project.
#
# You can pass your manifest repositories to west init when creating a
# new Zephyr installation. See the west documentation for more
# information.

manifest:
  defaults:
    remote: upstream

  remotes:
    - name: upstream
      url-base: https://github.com/zephyrproject-rtos

  group-filter: [-optional]

  #
  # Please add items below based on alphabetical order
  projects:
    - name: cmsis
      revision: 4b96cbb174678dcd3ca86e11e1f24bc5f8726da0
      path: modules/hal/cmsis
      groups:
        - hal
    - name: cmsis-dsp
      revision: 6489e771e9c405f1763b52d64a3f17a1ec488ace
      path: modules/lib/cmsis-dsp
    - name: cmsis-nn
      revision: ea987c1ca661be723de83bd159aed815d6cbd430
      path: modules/lib/cmsis-nn
    - name: hal_silabs
      revision: 69a5fad41aced94dc59d3103edd6ef370851e623
      path: modules/hal/silabs
      groups:
        - hal
    - name: libmetal
      revision: a6851ba6dba8c9e87d00c42f171a822f7a29639b
      path: modules/hal/libmetal
      groups:
        - hal
    - name: liblc3
      revision: 1a5938ebaca4f13fe79ce074f5dee079783aa29f
      path: modules/lib/liblc3
    - name: mipi-sys-t
      path: modules/debug/mipi-sys-t
      groups:
        - debug
      revision: 71ace1f5caa03e56c8740a09863e685efb4b2360
    - name: picolibc
      path: modules/lib/picolibc
      revision: d492d5fa7c96918e37653f303028346bb0dd51a2
    - name: segger
      revision: 798f95ea9304e5ed8165a661081443051f210733
      path: modules/debug/segger
      groups:
        - debug

  self:
    path: zephyr
    west-commands: scripts/west-commands.yml
    import: submanifests
```
